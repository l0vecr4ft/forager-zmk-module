#include "forager.dtsi"

// Remove kscan and physical-layout from chosen as the dongle doesn't have a physical keyboard matrix
/ {
    chosen {
        /delete-property/ zmk,kscan;
        /delete-property/ zmk,physical-layout;
    };
};

// The dongle doesn't have a physical keyboard, it only receives data from the split halves
&kscan0 {
    status = "disabled";
};
