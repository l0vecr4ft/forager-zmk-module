## boards/shields/forager/Kconfig.defconfig
```kconfig
# Copyright (c) 2024 The ZMK Contributors
# SPDX-License-Identifier: MIT

# ============================================
# FORAGER LEFT - Peripheral (quando usato con dongle)
# ============================================
if SHIELD_FORAGER_LEFT

config ZMK_KEYBOARD_NAME
    default "Forager"

# IMPORTANTE: Left è PERIPHERAL quando usi il dongle
# Se vuoi usare left come CENTRAL (senza dongle), vedi build.yaml

config ZMK_STUDIO
    default y

endif

# ============================================
# FORAGER RIGHT - Peripheral (quando usato con dongle)
# ============================================
if SHIELD_FORAGER_RIGHT

config ZMK_KEYBOARD_NAME
    default "Forager"

# IMPORTANTE: Right è PERIPHERAL quando usi il dongle
# Se vuoi usare right come CENTRAL (senza dongle), vedi build.yaml

config ZMK_STUDIO
    default y

endif

# ============================================
# FORAGER DONGLE - Central
# ============================================
if SHIELD_FORAGER_DONGLE

config ZMK_KEYBOARD_NAME
    default "Forager"

config ZMK_SPLIT
    default y

config ZMK_SPLIT_ROLE_CENTRAL
    default y

config ZMK_SPLIT_BLE_CENTRAL_PERIPHERALS
    default 2

endif

# ============================================
# SPLIT KEYBOARD - Configurazione generale
# ============================================
if SHIELD_FORAGER_LEFT || SHIELD_FORAGER_RIGHT

config ZMK_SPLIT
    default y

endif
```
